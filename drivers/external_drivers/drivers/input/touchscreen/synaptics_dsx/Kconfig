## drivers/external_drivers/drivers/input/touchscreen/synaptics_dsx/Kconfig
```kconfig
#
# Synaptics DSX touchscreen driver configuration
#
config TOUCHSCREEN_SYNAPTICS_DSX
	tristate "Synaptics DSX touchscreen"
	depends on I2C && INPUT
	help
	  Say Y here if you have a Synaptics DSX touchscreen connected
	  to your system.

	  To compile this driver as a module, choose M here: the
	  module will be called synaptics_dsx.
```

## drivers/external_drivers/drivers/leds/Kconfig
```kconfig
config LEDS_INTEL_KPD
        tristate "LED driver for Intel Keypad LED"
        depends on INTEL_SCU_IPC && MID_PWM
        help
          This option enables to support for Intel Keypad LED on Medfield Platform
          LED brightness can be controlled via sysfs.

          For detail information of sysfs control, Please refer to kernel document
          Documentation/ABI/testing/sysfs-class-led.

config LEDS_LP5560
	tristate "LED Support for N.S. LP5560 LED driver chip"
	depends on LEDS_CLASS
	help
	  If you say yes here you get support for the National Semiconductor
	  LP5560 LED driver. It is 1 channel chip with programmable engines.
	  Driver provides direct control via LED class and interface for
	  programming the engines.
```

## drivers/net/wireless/bcmdhd/Kconfig
```kconfig
config BCMDHD
	tristate "Broadcom BCM4334, 4335, 43241 wireless cards support"
	depends on MMC
	---help---
	  This module adds support for wireless adapters based on
	  Broadcom BCM4334, 4335, 43241 chipset.

	  This driver uses the kernel's wireless extensions subsystem.

	  If you choose to build a module, it'll be called bcmdhd. Say M if
	  unsure.

choice
	prompt "---Enable chip specific options"
	depends on BCMDHD
	---help---
		Enable specific chip.
config BCMDHD_GENERIC_CHIP_SUPPORT
	bool "No chip specific options"
	depends on BCMDHD
	---help---
		Disable any chip specific options.

config BCM4334
	bool "Broadcom BCM4334 support only"
	depends on BCMDHD
	---help---
		Enable any BCM4334 specific options.

config BCM4335
	bool "Broadcom BCM4335 support only"
	depends on BCMDHD
	---help---
		Enable any BCM4335 specific options.

config BCM43241
	bool "Broadcom BCM43241 support only"
	depends on BCMDHD
	---help---
		Enable any BCM43241 specific options.
endchoice

config INTEL_PLATFORM
	bool "Enable Intel specific flags"
	depends on BCMDHD
	default y
	---help---
	        Enable Intel specific flags

config BCMDHD_FW_PATH
	depends on BCMDHD
	string "Firmware path"
	default "/system/etc/firmware/fw_bcmdhd.bin"
	---help---
	  Path to the firmware file.

config BCMDHD_NVRAM_PATH
	depends on BCMDHD
	string "NVRAM path"
	default "/system/etc/wifi/bcmdhd.cal"
	---help---
	  Path to the calibration file.

config BCMDHD_WEXT
	bool "Enable WEXT support"
	depends on BCMDHD && CFG80211 = n
	select WIRELESS_EXT
	select WEXT_PRIV
	help
	  Enables WEXT support

config DHD_USE_STATIC_BUF
	bool "Enable memory preallocation"
	depends on BCMDHD
	default n
	---help---
	  Use memory preallocated in platform

config DHD_USE_SCHED_SCAN
	bool "Use CFG80211 sched scan"
	depends on BCMDHD && CFG80211
	default n
	---help---
	  Use CFG80211 sched scan
```
